## Kconfig
```kconfig
config ZMK_RGB_BATTERY_GUARD
    bool "Keep RGB underglow and LED power off while running on battery"
    default y
    depends on ZMK_RGB_UNDERGLOW && ZMK_EXT_POWER && ZMK_USB

config ZMK_RGB_BATTERY_GUARD_BOOT_DELAY_MS
    int "Delay after boot before the first check (lets saved settings load first)"
    default 2000
    depends on ZMK_RGB_BATTERY_GUARD
```

## config/west.yml
```yaml
manifest:
  remotes:
    - name: zmkfirmware
      url-base: https://github.com/zmkfirmware
    - name: prospector
      url-base: https://github.com/t-ogura
  projects:
    - name: zmk
      remote: zmkfirmware
      revision: v0.3 # pinned release; keep in sync with .github/workflows/build.yml
      import: app/west.yml
    - name: prospector-zmk-module
      remote: prospector
      revision: v2.2.3
      path: modules/prospector-zmk-module
  self:
    path: config
```

## docs/tools/ledtest/Kconfig
```kconfig
config LEDTEST
    bool "WS2812 chain walk + brightness step test"
    default y

config LEDTEST_WALK_ONLY
    bool "Only run the dim WALK + ALL OFF phases (no bright white steps)"
    default n
```

## docs/tools/pwrdiag/Kconfig
```kconfig
config PWRDIAG
    bool "nRF52840 power register diagnostics over log"
    default y
```
